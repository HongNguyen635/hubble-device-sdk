## Kconfig
```
# Copyright (c) 2026 Hubble Network, Inc.
# SPDX-License-Identifier: Apache-2.0

menu "Hubble Network Satellite Sample options"

config SAMPLE_PROVIDE_SAT_BOARD_SUPPORT
    bool "Provide satellite board support for test purpose"
    help
	Targets that support satellite must select it, otherwise
	board APIs will be mocked in the sample.

config SAMPLE_SAT_TX_INTERVAL_SECONDS
    int "Inter-transmission sleep in seconds"
    default 10
    help
	Time the sample sleeps between consecutive satellite packet
	transmissions, in seconds.

config SAMPLE_HUBBLE_KEY
    string "Base64-encoded Hubble master key"
    default ""
    help
	Base64-encoded master key provisioned at build time. Pass it with
	west build ... -- -DCONFIG_SAMPLE_HUBBLE_KEY=\"<base64 key>\".
	If left empty, an all-zero placeholder is used: the sample still
	builds but will not produce valid advertisements until a real key
	is supplied.

endmenu

source "Kconfig.zephyr"

module = APP
module-str = APP
source "subsys/logging/Kconfig.template.log_config"
```

## prj.conf
```kconfig
# Copyright (c) 2026 Hubble Network, Inc.
# SPDX-License-Identifier: Apache-2.0

# Hubble Network
CONFIG_HUBBLE_SAT_NETWORK=y

# Decode the base64 master key (passed via -DCONFIG_SAMPLE_HUBBLE_KEY)
CONFIG_BASE64=y

# Logging, so the key-provisioning warning/error and other status are visible.
CONFIG_LOG=y

# Use the device uptime counter source so the device does not need UTC time
# provisioned. The EID counter starts from the value passed to hubble_init()
# and advances with uptime.
CONFIG_HUBBLE_COUNTER_SOURCE_DEVICE_UPTIME=y

# Disable nonce-reuse enforcement for this sample. The check persists the
# sequence counter to NVS and rejects reused/decreasing counters; this sample
# transmits continuously and needs no NVS, so turn it off.
CONFIG_HUBBLE_NETWORK_SECURITY_ENFORCE_NONCE_CHECK=n

CONFIG_MAIN_STACK_SIZE=4096
```

## src/main.c
```c
/*
 * Copyright (c) 2026 Hubble Network, Inc.
 * SPDX-License-Identifier: Apache-2.0
 */

#include <hubble/hubble.h>
#include <hubble/sat/packet.h>

#include <zephyr/kernel.h>
#include <zephyr/logging/log.h>
#include <zephyr/sys/base64.h>

#ifdef CONFIG_SOC_FAMILY_ESPRESSIF_ESP32
#include <zephyr/bluetooth/bluetooth.h>
#endif

#include <errno.h>
#include <stdint.h>
#include <stdlib.h>
#include <string.h>

LOG_MODULE_REGISTER(main);

/*
 * Decoded master key. The SDK stores this pointer directly, so the buffer has
 * static storage duration and outlives all SDK calls. Zero-initialised, which
 * also serves as the all-zero placeholder when no key is provided.
 */
static uint8_t master_key[CONFIG_HUBBLE_KEY_SIZE];

/*
 * Decode the base64 master key (CONFIG_SAMPLE_HUBBLE_KEY, provisioned at build
 * time) into master_key, validating its length.
 */
static int master_key_provision(void)
{
	const char *key = CONFIG_SAMPLE_HUBBLE_KEY;
	size_t olen;
	int err;

	if (strlen(key) == 0) {
		LOG_WRN("CONFIG_SAMPLE_HUBBLE_KEY not set; using an all-zero "
			"placeholder key. Pass your base64 key with "
			"-DCONFIG_SAMPLE_HUBBLE_KEY=\"<key>\".");
		return 0;
	}

	err = base64_decode(master_key, sizeof(master_key), &olen, key,
			    strlen(key));
	if (err != 0 || olen != sizeof(master_key)) {
		LOG_ERR("Invalid CONFIG_SAMPLE_HUBBLE_KEY: expected a base64-"
			"encoded %u-byte key (matching CONFIG_HUBBLE_KEY_SIZE)",
			(unsigned int)sizeof(master_key));
		return -EINVAL;
	}

	return 0;
}

#ifdef CONFIG_SAMPLE_PROVIDE_SAT_BOARD_SUPPORT

int hubble_sat_board_init(void)
{
	return 0;
}

int hubble_sat_board_enable(void)
{
	return 0;
}

int hubble_sat_board_disable(void)
{
	return 0;
}

int hubble_sat_board_packet_send(const struct hubble_sat_packet_frames *packet)
{
	ARG_UNUSED(packet);

	return 0;
}

#endif /* CONFIG_SAMPLE_PROVIDE_SAT_BOARD_SUPPORT */


int main(void)
{
	int err = 0;
	struct hubble_sat_packet pkt;

	LOG_DBG("Hubble Network Sat Sample started");

	err = master_key_provision();
	if (err != 0) {
		goto end;
	}

#ifdef CONFIG_SOC_FAMILY_ESPRESSIF_ESP32
	err = bt_enable(NULL);
	if (err != 0) {
		LOG_ERR("Bluetooth init failed (err %d)", err);
		goto end;
	}
#endif /* CONFIG_SOC_FAMILY_ESPRESSIF_ESP32 */

	/*
	 * This sample uses the device uptime counter source
	 * (CONFIG_HUBBLE_COUNTER_SOURCE_DEVICE_UPTIME), so no UTC time is needed:
	 * we pass 0 as the initial EID counter value and it advances with uptime.
	 */
	err = hubble_init(0, master_key);
	if (err != 0) {
		LOG_ERR("Failed to initialize Hubble Sat Network");
		goto end;
	}

	for (;;) {
		err = hubble_sat_packet_get(&pkt, NULL, 0);
		if (err != 0) {
			LOG_ERR("Failed to get Hubble Sat Network packet");
			goto end;
		}

		/* Set reliability to NONE - this will trigger a single
		 * transmission instead of a sequence. This is only for testing
		 * purposes and not recommended for production.
		 */
		err = hubble_sat_packet_send(&pkt, HUBBLE_SAT_RELIABILITY_NONE);
		if (err != 0) {
			LOG_ERR("Failed to transmit packet");
			goto end;
		}

		k_sleep(K_SECONDS(CONFIG_SAMPLE_SAT_TX_INTERVAL_SECONDS));
	}

end:
	return err;
}
```
